## firmware/main/Kconfig.projbuild
```kconfig
menu "ESP32 EFIS development options"

config EFIS_BENCH_SIMULATION
    bool "Enable synthetic bench flight data"
    default n
    help
        Development and emulator use only. Generates synthetic attitude,
        altitude and heading data. Leave disabled for normal hardware and
        aircraft-use builds. When enabled the display clearly identifies
        the data as simulated.

config EFIS_QEMU
    bool "Use Espressif QEMU virtual RGB display"
    default n
    depends on EFIS_BENCH_SIMULATION
    help
        Emulator development only. Replaces physical LCD, MCP23008, encoder,
        backlight and BMI088 initialization with Espressif's QEMU virtual RGB
        panel. Never enable this option for hardware or aircraft-use builds.

config EFIS_BMI088_DIAGNOSTICS
    bool "Enable BMI088 axis commissioning diagnostics"
    default n
    depends on !EFIS_QEMU
    help
        Bench commissioning only. Logs raw BMI088 accelerometer and gyro
        engineering-unit samples plus acceleration magnitude at approximately
        5 Hz so the installed Shuttle Board axis/sign mapping can be verified.
        This option does not feed BMI088 data into the flight display and must
        remain disabled for normal aircraft-use builds.

config EFIS_RM3100_DIAGNOSTICS
    bool "Enable RM3100 remote magnetometer bench diagnostics"
    default n
    depends on !EFIS_QEMU
    help
        Bench-only I2C diagnostics; never feeds the heading display.

config EFIS_RM3100_I2C_ADDRESS
    hex "RM3100 I2C address"
    depends on EFIS_RM3100_DIAGNOSTICS
    range 0x20 0x23
    default 0x20

endmenu
```
